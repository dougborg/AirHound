## firmware-std/sdkconfig.defaults
```kconfig
CONFIG_ESP_MAIN_TASK_STACK_SIZE=8000
CONFIG_FREERTOS_HZ=1000

# NimBLE (not Bluedroid — less RAM)
CONFIG_BT_ENABLED=y
CONFIG_BT_BLE_ENABLED=y
CONFIG_BT_BLUEDROID_ENABLED=n
CONFIG_BT_NIMBLE_ENABLED=y
CONFIG_BT_NIMBLE_MAX_CONNECTIONS=3
CONFIG_BT_NIMBLE_ROLE_PERIPHERAL=y
CONFIG_BT_NIMBLE_ROLE_BROADCASTER=y
CONFIG_BT_NIMBLE_ROLE_OBSERVER=y
CONFIG_BT_NIMBLE_ROLE_CENTRAL=n

# WiFi + BLE coexistence
CONFIG_SW_COEXIST_ENABLE=y
CONFIG_ESP_WIFI_STA_DISCONNECTED_PM_ENABLE=n
```

## firmware-std/sdkconfig.defaults.esp32
```kconfig
CONFIG_BTDM_CTRL_MODE_BLE_ONLY=y
CONFIG_BTDM_CTRL_PINNED_TO_CORE=0
CONFIG_BT_NIMBLE_PINNED_TO_CORE=0
CONFIG_ESP_WIFI_TASK_CORE_ID=1
CONFIG_BTDM_CTRL_FULL_SCAN_SUPPORTED=y
```
